## boards/shields/HawkV02/Kconfig.defconfig
```kconfig
if SHIELD_HAWKV02_LEFT

config ZMK_KEYBOARD_NAME
    default "HawkV02"

config ZMK_SPLIT_ROLE_CENTRAL
    default y

endif

if SHIELD_HAWKV02_LEFT || SHIELD_HAWKV02_RIGHT
    
config ZMK_SPLIT
    default y

endif
```

## boards/shields/HawkV02/Kconfig.shield
```kconfig
config SHIELD_HAWVK02_LEFT
    def_bool $(shields_list_contains,HawkV02_left)

config SHIELD_HAWKV02_RIGHT
    def_bool $(shields_list_contains,HawkV02_right)
```
